// Copyright 2022 Manna Harbour
// https://github.com/manna-harbour/miryoku

#include "../miryoku/custom_config.h"
#include "../miryoku/mapping/38/totem.h"
#include "../miryoku/miryoku.dtsi"
/ {
    combos {
        compatible = "zmk,combos";
        HENRI_COMBO_MACRO(esc, U_BASE, 6 7, &kp ESC)
        HENRI_COMBO_MACRO(repeat, U_BASE, 27 28, &key_repeat)
    };
};
