// Copyright 2021 Manna Harbour
// https://github.com/manna-harbour/miryoku

#include "../miryoku/custom_config.h"
#include "../miryoku/mapping/42/corne.h"
#include "../miryoku/miryoku.dtsi"
/ {
    combos {
        compatible = "zmk,combos";
        // HENRI_COMBO_MACRO(q, U_BASE, MIRYOKU_KLUDGE_TOPROWCOMBOS_LEFTPINKIE, &kp Q)
        // HENRI_COMBO_MACRO(q, U_SYM, MIRYOKU_KLUDGE_TOPROWCOMBOS_LEFTPINKIE, &kp LEFT_BRACE)
        // HENRI_COMBO_MACRO(q, U_NUM, MIRYOKU_KLUDGE_TOPROWCOMBOS_LEFTPINKIE, &kp LEFT_BRACKET)
        // HENRI_COMBO_MACRO(z, U_BASE, MIRYOKU_KLUDGE_BOTTOMROWCOMBOS_LEFTPINKIE, &kp Z)
        // HENRI_COMBO_MACRO(z, U_SYM, MIRYOKU_KLUDGE_BOTTOMROWCOMBOS_LEFTPINKIE, &kp TILDE)
        // HENRI_COMBO_MACRO(z, U_NUM, MIRYOKU_KLUDGE_BOTTOMROWCOMBOS_LEFTPINKIE, &kp GRAVE)
        // HENRI_COMBO_MACRO(slash, U_BASE, MIRYOKU_KLUDGE_BOTTOMROWCOMBOS_RIGHTPINKIE, &kp SLASH)
        // HENRI_COMBO_MACRO(slash, U_NAV, MIRYOKU_KLUDGE_BOTTOMROWCOMBOS_RIGHTPINKIE, &kp END)
        // HENRI_COMBO_MACRO(slash, U_MOUSE, MIRYOKU_KLUDGE_BOTTOMROWCOMBOS_RIGHTPINKIE, U_WH_R)
        // HENRI_COMBO_MACRO(quote, U_BASE, MIRYOKU_KLUDGE_TOPROWCOMBOS_RIGHTPINKIE, &kp SINGLE_QUOTE)
        // HENRI_COMBO_MACRO(quote, U_NAV, MIRYOKU_KLUDGE_TOPROWCOMBOS_RIGHTPINKIE, U_UND)
        // HENRI_COMBO_MACRO(quote, U_MOUSE, MIRYOKU_KLUDGE_TOPROWCOMBOS_RIGHTPINKIE, U_UND)

        HENRI_COMBO_MACRO(esc, U_BASE, 7 8, &kp ESC)
        HENRI_COMBO_MACRO(repeat, U_BASE, 31 32, &key_repeat)
    };
};
